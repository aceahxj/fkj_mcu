/***************************************************************
*  FileName              :    adc.c
*  Copyright             :
*  ModuleName            :
*
*  CPU                   :
*  RTOS                  :

*  CreateData            :
*  Author/Corporation    :
*
*  Description           :    adc驱动
*
*---------------------Revision History------------------------
*  No    Version    Date    Revised By    Item    Description
*
*
***************************************************************/
#define  ADC_GLOBALS

/*
*********************************************************************************************************
*                                              INCLUDE FILES
*********************************************************************************************************
*/

#include "adc.h"
#include "delay.h"
#include "bsp.h"
#include "stm32f0xx_adc.h"
#include "stm32f0xx_dma.h"

/*
*********************************************************************************************************
*                                               CONSTANTS
*********************************************************************************************************
*/

/*
*********************************************************************************************************
*                                             PERIPH DEFINES
*********************************************************************************************************
*/

/*
*********************************************************************************************************
*                                               DATA TYPES
*********************************************************************************************************
*/

/*
*********************************************************************************************************
*                                            GLOBAL VARIABLES
*********************************************************************************************************
*/

/*
*********************************************************************************************************
*                                                 MACRO'S
*********************************************************************************************************
*/


/*
*********************************************************************************************************
*                                           FUNCTION PROTOTYPES
*********************************************************************************************************
*/


/**************************************************************
*  Function Name         :   buffer_avg
*  Param                 :   void
*  Return Param          :   UINT16
*  Description           :   获取平均值
***************************************************************/
static UINT16 buffer_avg(void * data)
{
    UINT16 avgdata = 0;
	UINT32 sum = 0;
	UINT8 idx;

	for(idx = 0;idx < ADCCONV_NUM;idx++)
	{
		feedwwdg();
        sum += (UINT32)(((UINT16 *)data)[idx]);
	}

	avgdata = (UINT16)(sum >> 6);
	return avgdata;
}

/**************************************************************
*  Function Name         :   getadcvalue
*  Param                 :   const void * data, UINT8 length
*  Return Param          :   UINT16
*  Description           :   获取adc转换结果
***************************************************************/
 UINT16 getadcvalue(UINT32 ADC_Channel)
{
    UINT16 adcresult = 0;
    UINT16 idx;
    UINT16 atomizevalue[ADCCONV_NUM];            								//采样电流保存数组

	ADC_CHNL_NONE;																//先把采样通道清0
	ADC_ChannelConfig(ADC1, ADC_Channel, ADC_SampleTime_1_5Cycles);				//单独配置需要采样的通道

	atomizevalue[0] = ADC1->DR;													//先读走上一通道的残留数据
    while(ADC_GetFlagStatus(ADC1,ADC_FLAG_ADRDY) == DISABLE);

    ADC_ClearFlag(ADC1,ADC_FLAG_EOC);
	ADC_ClearFlag(ADC1, ADC_FLAG_OVR);
	ADC_StartOfConversion(ADC1);
    for(idx = 0;idx < ADCCONV_NUM;idx++)
    {
		while (!(ADC1->ISR & 0x04))
			feedwwdg();
		atomizevalue[idx] = ADC1->DR;
    }
	ADC_StopOfConversion(ADC1);
    adcresult = buffer_avg((void *)atomizevalue);
    return adcresult;
}



